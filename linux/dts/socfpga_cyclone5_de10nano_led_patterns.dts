#include "socfpga_cyclone5_de10nano.dtsi"


/{

    leds {
        compatible = "gpio-leds";
        led-hps0 {
            color = <2>;
            function = "heartbeat";
            gpios = <&portb 24 0>;
            linux,default-trigger = "heartbeat";
        };
    };

    led_patterns: led_patterns@ff245A80 {
        compatible = "Holmes,led_patterns";
        reg = <0xff245A80 16>;
    };

};